## drivers/input/touchscreen/nt36672a/Kconfig
```kconfig
#
# Novatek NT36xxx touchscreen driver configuration, Copyright (C) 2022 SERDELIUK mainlining
#
config TOUCHSCREEN_NT36672A
	bool "Novatek NT36xxx host download SPI driver"
	default y
	select SPI 
	select SPI_MASTER
	help
	  Say Y here if you have a Novatek NT36xxx no flash touchscreen connected
	  to your system by SPI bus.

	  If unsure, say N.
```
